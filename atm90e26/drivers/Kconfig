## atm90e26/drivers/sensor/m90e26/Kconfig
```kconfig
config M90E26
    bool "Atmel M90E26 energy metering IC"
    default n
    depends on DT_HAS_ATMEL_M90E26_ENABLED
    select UART_ASYNC_API
    help
      Enable driver for the Atmel M90E26 energy metering IC using UART.
```

## atm90e26/dts/bindings/sensor/atmel,m90e26.yaml
```yaml
# dts/bindings/sensor/atmel,m90e26.yaml

description: Atmel M90E26 Single-Phase Energy Metering IC (UART)

compatible: "atmel,m90e26"

include: base.yaml

on-bus: uart
```

## boards/tj3/Kconfig.tj3
```kconfig
# Copyright (c) 2025 Generated by nRF54L Pin Planner
# SPDX-License-Identifier: Apache-2.0

config BOARD_TJ3
	select SOC_NRF54L15_CPUAPP if BOARD_TJ3_NRF54L15_CPUAPP || BOARD_TJ3_NRF54L15_CPUAPP_NS
```

## boards/tj3/board.yml
```yaml
board:
  name: tj3
  full_name: nRF54L15 TJ3
  vendor: custom
  socs:
    - name: nrf54l15
      variants:
        - name: ns
          cpucluster: cpuapp
runners:
  run_once:
    '--recover':
      - runners:
          - nrfjprog
          - nrfutil
        run: first
        groups:
          - boards:
              - tj3/nrf54l15/cpuapp
              - tj3/nrf54l15/cpuapp/ns
    '--erase':
      - runners:
          - nrfjprog
          - jlink
          - nrfutil
        run: first
        groups:
          - boards:
              - tj3/nrf54l15/cpuapp
              - tj3/nrf54l15/cpuapp/ns
    '--reset':
      - runners:
          - nrfjprog
          - jlink
          - nrfutil
        run: last
        groups:
          - boards:
              - tj3/nrf54l15/cpuapp
              - tj3/nrf54l15/cpuapp/ns
```

## drivers/sensor/atm90e26/Kconfig
```kconfig
# drivers/sensor/atm90e26/Kconfig

menu "TJ3_DRIVERS"
    menu "Sensor drivers"
        config ATM90E26
            bool "ATM90E26 Energy Monitoring IC"
            default y
            select UART_INTERRUPT_DRIVEN
            help
                Enable driver for Atmel ATM90E26 energy monitoring chip connected via UART.
    endmenu
endmenu
```

## tj3_comm/Kconfig
```kconfig
menuconfig TJ3_COMM
	bool "TJ3 communication modules"
	default y
	help
	  Communication helpers for TJ3 app: framing/protocol, BLE passthrough, and
	  UART link to nRF9151.

if TJ3_COMM

config TJ3_COMM_PROTOCOL
	bool "TJ3 framing/protocol"
	default y
	help
	  Enables frame encode/decode helpers used by BLE and UART links.

config TJ3_COMM_NRF9151_LINK
	bool "UART link to nRF9151"
	default y
	select UART_ASYNC_API
	help
	  Enables UART async transport for frames to/from nRF9151.

config TJ3_COMM_BLE
	bool "BLE GATT (write/notify)"
	default y
	depends on BT
	help
	  Exposes a simple GATT service with one RX (write) and one TX (notify)
	  characteristic.

config TJ3_COMM_MAX_PAYLOAD
	int "Max protocol payload (bytes)"
	default 244
	help
	  Maximum payload length accepted by the frame parser.

endif # TJ3_COMM
```
